## buildroot-external/configs/kexecboot_defconfig
```kconfig
BR2_x86_64=y
BR2_x86_corei7=y
BR2_TOOLCHAIN_BUILDROOT_GLIBC=y
BR2_PACKAGE_HOST_LINUX_HEADERS_CUSTOM_6_1=y
BR2_ROOTFS_DEVICE_CREATION_DYNAMIC_EUDEV=y
BR2_SYSTEM_DHCP="eth0"
BR2_LINUX_KERNEL=y
BR2_LINUX_KERNEL_CUSTOM_VERSION=y
BR2_LINUX_KERNEL_CUSTOM_VERSION_VALUE="6.1.60"
BR2_LINUX_KERNEL_USE_CUSTOM_CONFIG=y
BR2_LINUX_KERNEL_CUSTOM_CONFIG_FILE="$(BR2_EXTERNAL_KEXECBOOT_PATH)/board/kexecboot/linux.config"
BR2_LINUX_KERNEL_INSTALL_TARGET=y
BR2_PACKAGE_IWD=y
BR2_PACKAGE_KEXEC=y
BR2_PACKAGE_KEXEC_ZLIB=y
BR2_PACKAGE_LINUX_FIRMWARE=y
BR2_PACKAGE_LINUX_FIRMWARE_ATHEROS_9271=y
BR2_PACKAGE_LINUX_FIRMWARE_ATHEROS_9271_AP=y
BR2_PACKAGE_LINUX_FIRMWARE_IWLWIFI_3160=y
BR2_PACKAGE_LINUX_FIRMWARE_IWLWIFI_3168=y
BR2_PACKAGE_LINUX_FIRMWARE_IWLWIFI_5000=y
BR2_PACKAGE_LINUX_FIRMWARE_IWLWIFI_6000G2A=y
BR2_PACKAGE_LINUX_FIRMWARE_IWLWIFI_6000G2B=y
BR2_PACKAGE_LINUX_FIRMWARE_IWLWIFI_7260=y
BR2_PACKAGE_LINUX_FIRMWARE_IWLWIFI_7265=y
BR2_PACKAGE_LINUX_FIRMWARE_IWLWIFI_8000C=y
BR2_PACKAGE_LINUX_FIRMWARE_IWLWIFI_8265=y
BR2_PACKAGE_LINUX_FIRMWARE_IWLWIFI_9000=y
BR2_PACKAGE_LINUX_FIRMWARE_IWLWIFI_9260=y
BR2_PACKAGE_LINUX_FIRMWARE_MEDIATEK=y
BR2_PACKAGE_LINUX_FIRMWARE_REALTEK=y
BR2_PACKAGE_KEXECBOOT_TUI=y
BR2_TARGET_ROOTFS_CPIO=y
BR2_TARGET_ROOTFS_CPIO_GZIP=y
BR2_TARGET_ROOTFS_EXT2=y
BR2_TARGET_ROOTFS_EXT2_4=y
BR2_TARGET_GRUB2=y
BR2_TARGET_GRUB2_X86_64_EFI=y
BR2_TARGET_GRUB2_BOOT_PARTITION="ext2"
BR2_TARGET_GRUB2_BUILTIN_MODULES_EFI="boot linux ext2 fat squashfs part_msdos part_gpt normal efi_gop"
BR2_ROOTFS_OVERLAY="$(BR2_EXTERNAL_KEXECBOOT_PATH)/board/kexecboot/rootfs-overlay"
```

## buildroot-external/package/kexecboot-tui/Config.in
```kconfig
config BR2_PACKAGE_KEXECBOOT_TUI
	bool "kexecboot-tui"
	depends on BR2_PACKAGE_HOST_GO_TARGET_ARCH_SUPPORTS
	help
	  Go TUI for Wi-Fi Native Network Bootloader

	  https://github.com/RPDevs-Builds/kexecboot.xyz
```
